/**-------------------------------------------------------------------------
@file	assign_core_test.c

@brief	Host test support: assign core test.

@license

MIT License

Copyright (c) 2019 I-SYST inc. All rights reserved.

Permission is hereby granted, free of charge, to any person obtaining a copy
of this software and associated documentation files (the "Software"), to deal
in the Software without restriction, including without limitation the rights
to use, copy, modify, merge, publish, distribute, sublicense, and/or sell
copies of the Software, and to permit persons to whom the Software is
furnished to do so, subject to the following conditions:

The above copyright notice and this permission notice shall be included in all
copies or substantial portions of the Software.

THE SOFTWARE IS PROVIDED "AS IS", WITHOUT WARRANTY OF ANY KIND, EXPRESS OR
IMPLIED, INCLUDING BUT NOT LIMITED TO THE WARRANTIES OF MERCHANTABILITY,
FITNESS FOR A PARTICULAR PURPOSE AND NONINFRINGEMENT. IN NO EVENT SHALL THE
AUTHORS OR COPYRIGHT HOLDERS BE LIABLE FOR ANY CLAIM, DAMAGES OR OTHER
LIABILITY, WHETHER IN AN ACTION OF CONTRACT, TORT OR OTHERWISE, ARISING FROM,
OUT OF OR IN CONNECTION WITH THE SOFTWARE OR THE USE OR OTHER DEALINGS IN THE
SOFTWARE.
----------------------------------------------------------------------------*/

#include <assert.h>
#include <string.h>
#include "coredev/iopincfg.h"

typedef struct { uint32_t PIN_CNF[32]; } NRF_GPIO_Type;
typedef struct { uint32_t PERM; uint32_t LOCK; } PortPermission;
typedef struct { PortPermission GPIOPORT[2]; } Spu;
static NRF_GPIO_Type s_Gpio[2];
static Spu s_Spu;
static uint32_t s_IrqState;
static unsigned s_Barriers;
static unsigned s_RegLookups;

#define NRF_SPU_S (&s_Spu)
#define GPIO_COUNT 2
#define P0_PIN_NUM 32
#define P1_PIN_NUM 16
#define GPIO_PIN_CNF_MCUSEL_Pos 28
#define GPIO_PIN_CNF_MCUSEL_Msk (7UL << 28)
#define GPIO_PIN_CNF_MCUSEL_AppMCU 0UL
#define GPIO_PIN_CNF_MCUSEL_NetworkMCU 1UL
#define SPU_GPIOPORT_LOCK_LOCK_Msk 1UL
#define __DSB() (++s_Barriers)

uint32_t DisableInterrupt(void)
{
	uint32_t previous = s_IrqState;
	s_IrqState = 1;
	return previous;
}

void EnableInterrupt(uint32_t State)
{
	s_IrqState = State;
}

NRF_GPIO_Type *nRFGpioGetReg(int PortNo)
{
	s_RegLookups++;
	assert(PortNo >= 0 && PortNo < 2);
	return &s_Gpio[PortNo];
}

// Generated by run_assign_core.py from the production function, unchanged.
#include "assign_core.inc"

int main(void)
{
	NRF_GPIO_Type before[2];
	Spu permissions;
	const uint32_t electrical = 0x0003030FUL;
	unsigned p;
	unsigned n;

	assert(s_Barriers == 0);

	for (p = 0; p < 2; p++)
	{
		for (n = 0; n < 32; n++)
		{
			s_Gpio[p].PIN_CNF[n] = electrical;
		}
		s_Spu.GPIOPORT[p].PERM = 0xFFFFFFFFUL;
	}
	memcpy(before, s_Gpio, sizeof(before));
	permissions = s_Spu;
	assert(!IOPinAssignCore(-1, 8, 1));
	assert(!IOPinAssignCore(2, 8, 1));
	assert(!IOPinAssignCore(1, -1, 1));
	assert(!IOPinAssignCore(1, 16, 1));
	assert(!IOPinAssignCore(0, 32, 1));
	assert(!IOPinAssignCore(1, 8, -1));
	assert(!IOPinAssignCore(1, 8, 2));
	assert(!memcmp(before, s_Gpio, sizeof(before)));
	assert(!memcmp(&permissions, &s_Spu, sizeof(permissions)));
	assert(s_RegLookups == 0);

#if defined(NRF5340_XXAA_APPLICATION) && !defined(NRF_TRUSTZONE_NONSECURE)
	assert(IOPinAssignCore(1, 8, 1));
	assert(IOPinAssignCore(1, 9, 1));
	assert(s_IrqState == 0);
	assert(s_Barriers >= 2);
	for (p = 0; p < 2; p++)
	{
		for (n = 0; n < 32; n++)
		{
			assert(s_Gpio[p].PIN_CNF[n] ==
				(electrical | ((p == 1 && (n == 8 || n == 9)) ? 1UL << 28 : 0)));
		}
	}
	assert(s_Spu.GPIOPORT[0].PERM == 0xFFFFFFFFUL);
	assert(s_Spu.GPIOPORT[1].PERM == (0xFFFFFFFFUL & ~0x300UL));

	// Repeated assignment works even when already non-secure and locked.
	s_Spu.GPIOPORT[1].LOCK = 1;
	assert(IOPinAssignCore(1, 8, 1));
	assert(IOPinAssignCore(1, 8, 0));
	assert(s_Gpio[1].PIN_CNF[8] == electrical);
	assert(s_Spu.GPIOPORT[1].PERM == (0xFFFFFFFFUL & ~0x300UL));

	// Locked secure permission rejects the handoff without changing pins.
	memcpy(before, s_Gpio, sizeof(before));
	permissions = s_Spu;
	s_IrqState = 1;
	assert(!IOPinAssignCore(1, 10, 1));
	assert(s_IrqState == 1);
	assert(!memcmp(before, s_Gpio, sizeof(before)));
	assert(!memcmp(&permissions, &s_Spu, sizeof(permissions)));
	s_Spu.GPIOPORT[1].LOCK = 0;
	assert(IOPinAssignCore(1, 15, 1));
	assert(IOPinAssignCore(0, 31, 1));
	assert(s_IrqState == 1);
#elif defined(NRF52_SERIES)
	assert(IOPinAssignCore(0, 31, 0));
	assert(IOPinAssignCore(1, 15, 0));
	assert(!IOPinAssignCore(1, 8, 1));
	assert(!memcmp(before, s_Gpio, sizeof(before)));
	assert(!memcmp(&permissions, &s_Spu, sizeof(permissions)));
	assert(s_RegLookups == 0);
#else
	assert(!IOPinAssignCore(1, 8, 0));
	assert(!IOPinAssignCore(1, 8, 1));
	assert(!memcmp(before, s_Gpio, sizeof(before)));
	assert(!memcmp(&permissions, &s_Spu, sizeof(permissions)));
	assert(s_RegLookups == 0);
#endif
	return 0;
}
