/**-------------------------------------------------------------------------
@file	bt_crypto_fw.cpp

@brief	STM32WBA Bluetooth crypto hooks, emulator test firmware

Links the real bt_wba_platform.cpp and bt_wba_pka.cpp and calls the functions
the Cube BLE stack calls: BAES_EcbCrypt, BAES_CmacSetKey, BAES_CmacCompute,
BAES_CcmCrypt, PKACTRL_* and HW_RNG_Get. Expected values are generated by
run_bt_crypto.py with the python cryptography package and come in through
bt_vectors.h. The queue of the Bluetooth event task is a stub that the test
pumps by hand, so the sequencer code of the platform file runs as it does on
the target.

The emulator preempts a CMAC or CCM at a chosen AES block and runs BtFwIsr,
which calls BAES_EcbCrypt as a radio interrupt would. The task level result
and the interrupt level result must both be right.

Not hardware validation.

@author	Hoang Nguyen Hoan
@date	Oct. 18, 2026

@license

MIT License

Copyright (c) 2026, I-SYST inc., all rights reserved

Permission is hereby granted, free of charge, to any person obtaining a copy
of this software and associated documentation files (the "Software"), to deal
in the Software without restriction, including without limitation the rights
to use, copy, modify, merge, publish, distribute, sublicense, and/or sell
copies of the Software, and to permit persons to whom the Software is furnished
to do so, subject to the following conditions:

The above copyright notice and this permission notice shall be included in all
copies or substantial portions of the Software.

THE SOFTWARE IS PROVIDED "AS IS", WITHOUT WARRANTY OF ANY KIND, EXPRESS OR
IMPLIED, INCLUDING BUT NOT LIMITED TO THE WARRANTIES OF MERCHANTABILITY,
FITNESS FOR A PARTICULAR PURPOSE AND NONINFRINGEMENT. IN NO EVENT SHALL THE
AUTHORS OR COPYRIGHT HOLDERS BE LIABLE FOR ANY CLAIM, DAMAGES OR OTHER
LIABILITY, WHETHER IN AN ACTION OF CONTRACT, TORT OR OTHERWISE, ARISING FROM,
OUT OF OR IN CONNECTION WITH THE SOFTWARE OR THE USE OR OTHER DEALINGS IN THE
SOFTWARE.

----------------------------------------------------------------------------*/
#include <stdint.h>
#include <stddef.h>
#include <string.h>
#include <stdio.h>

#include "bt_vectors.h"

extern "C" {
void BAES_Reset(void);
void BAES_EcbCrypt(const uint8_t *pKey, const uint8_t *pIn, uint8_t *pOut, int bEnc);
void BAES_CmacSetKey(const uint8_t *pKey);
void BAES_CmacCompute(const uint8_t *pIn, uint32_t Size, uint8_t *pOut);
int BAES_CcmCrypt(uint8_t Mode, const uint8_t *pKey, uint8_t IvLen,
				  const uint8_t *pIv, uint16_t AddLen, const uint8_t *pAdd,
				  uint16_t InLen, const uint8_t *pIn, uint8_t TagLen,
				  uint8_t *pTag, uint8_t *pOut);
void HW_RNG_Get(uint8_t n, uint32_t *pVal);
void PKACTRL_Reset(void);
int PKACTRL_StartP256Key(const uint32_t *pLocalPrivateKey);
int PKACTRL_ReadP256Key(uint32_t *pLocalPublicKey);
int PKACTRL_StartDhKey(const uint32_t *pLocalPrivateKey, const uint32_t *pRemotePublicKey);
int PKACTRL_ReadDhKey(uint32_t *pDhKey);

// Hooked by the emulator
void BtFwArm(int BlockNo) __attribute__((noinline));
void BtFwTrap(void) __attribute__((noinline));
void CryptoFwConsole(const char *pStr, int Len) __attribute__((noinline));
void CryptoFwDone(void) __attribute__((noinline));

volatile int32_t g_CryptoFwResult = -1000;
// Written by the emulator: number of preemptions it made
volatile int32_t g_Preempts = 0;
}

//----------------------------------------------------------------------------
// Stubs of what the platform file takes from the rest of the system
//----------------------------------------------------------------------------

typedef void (*BtFwHandler_t)(uint32_t EvtId, void *pCtx);

#define BT_FW_QUE_LEN	4

static BtFwHandler_t s_QueHandler[BT_FW_QUE_LEN];
static void *s_QueCtx[BT_FW_QUE_LEN];
static int s_QueCnt;

extern "C" bool BtEvtQue(uint32_t EvtId, void *pCtx, BtFwHandler_t Handler)
{
	(void)EvtId;
	if (s_QueCnt >= BT_FW_QUE_LEN)
	{
		return false;
	}
	s_QueHandler[s_QueCnt] = Handler;
	s_QueCtx[s_QueCnt] = pCtx;
	s_QueCnt++;

	return true;
}

// Run what the platform queued, the way the event task of the application does
static void BtFwPump(void)
{
	while (s_QueCnt > 0)
	{
		BtFwHandler_t h = s_QueHandler[0];
		void *c = s_QueCtx[0];

		for (int i = 1; i < s_QueCnt; i++)
		{
			s_QueHandler[i - 1] = s_QueHandler[i];
			s_QueCtx[i - 1] = s_QueCtx[i];
		}
		s_QueCnt--;
		h(0, c);
	}
}

extern "C" void BLEPLATCB_TimerExpiry(uint8_t Id) { (void)Id; }
extern "C" void BleStackCB_Process(void) {}
extern "C" bool TimerInit(void *pTimer, const void *pCfg) { (void)pTimer; (void)pCfg; return false; }
extern "C" uint32_t ll_intf_cmn_set_temperature_value(uint32_t t) { return t; }
extern "C" uint8_t g_McuOsc[64];
uint8_t g_McuOsc[64];
extern "C" void (*radio_callback)(void);
void (*radio_callback)(void);
extern "C" void (*low_isr_callback)(void);
void (*low_isr_callback)(void);
extern "C" volatile uint8_t radio_sw_low_isr_is_running_high_prio;
volatile uint8_t radio_sw_low_isr_is_running_high_prio;

extern "C" void Error_Handler(void)
{
	printf("  [FAIL] Error_Handler called\r\n");
	CryptoFwDone();
	while (1)
	{
	}
}

static volatile bool s_PkaDone;

extern "C" void PKACTRL_CB_Complete(void)
{
	s_PkaDone = true;
}

//----------------------------------------------------------------------------
// Emulator hooks and console
//----------------------------------------------------------------------------

extern "C" void BtFwArm(int BlockNo)
{
	__asm volatile ("" : : "r" (BlockNo) : "memory");
}

extern "C" void BtFwTrap(void)
{
	__asm volatile ("" ::: "memory");
	while (1)
	{
	}
}

extern "C" void CryptoFwConsole(const char *pStr, int Len)
{
	__asm volatile ("" : : "r" (pStr), "r" (Len) : "memory");
}

extern "C" void CryptoFwDone(void)
{
	__asm volatile ("" ::: "memory");
}

extern "C" int _write(int Fd, const char *pBuf, int Len)
{
	(void)Fd;
	CryptoFwConsole(pBuf, Len);

	return Len;
}

extern "C" void __cxa_pure_virtual(void)
{
	while (1)
	{
	}
}

void operator delete(void *) noexcept {}
void operator delete(void *, size_t) noexcept {}

//----------------------------------------------------------------------------
// Test
//----------------------------------------------------------------------------

static int s_Pass;
static int s_Fail;

static void check(const char *pName, bool bOk)
{
	printf("  [%s] %s\r\n", bOk ? "PASS" : "FAIL", pName);
	if (bOk)
	{
		s_Pass++;
	}
	else
	{
		s_Fail++;
	}
}

// Preemption routine. The emulator calls it at a chosen AES block of a task
// level operation, with the return address at BtFwTrap.
static volatile int s_IsrRuns;
static volatile bool s_IsrOk;

extern "C" void BtFwIsr(void)
{
	uint8_t out[16];

	BAES_EcbCrypt(g_EcbKey[0], g_EcbIn[0], out, 1);
	s_IsrOk = memcmp(out, g_EcbOut[0], 16) == 0;
	s_IsrRuns = s_IsrRuns + 1;
}

// Keeps the routines the emulator enters by address out of the linker's
// garbage collection
extern "C" void (* const g_BtFwEntries[])(void);
void (* const g_BtFwEntries[])(void) = { BtFwIsr, BtFwTrap };

static void EcbVectors(void)
{
	bool ok = true;

	BAES_Reset();
	for (unsigned i = 0; i < BT_NUM_ECB; i++)
	{
		uint8_t out[16];

		BAES_EcbCrypt(g_EcbKey[i], g_EcbIn[i], out, 1);
		ok = ok && memcmp(out, g_EcbOut[i], 16) == 0;
	}
	check("BAES_EcbCrypt, ST byte order", ok);
}

static void CmacVectors(void)
{
	bool ok = true;

	for (unsigned i = 0; i < BT_NUM_CMAC; i++)
	{
		uint8_t tag[16];

		BAES_CmacSetKey(g_CmacCase[i].Key);
		memset(tag, 0xA5, sizeof(tag));
		BAES_CmacCompute(g_CmacCase[i].Msg, g_CmacCase[i].Len, tag);
		ok = ok && memcmp(tag, g_CmacCase[i].Tag, 16) == 0;
	}
	check("BAES_CmacCompute, lengths 0 to 251", ok);

	ok = true;
	for (unsigned i = 0; i < BT_NUM_CMAC; i++)
	{
		const BtCmacCase_t *pC = &g_CmacCase[i];

		for (uint32_t split = 0; split < pC->Len || split == 0; split += 16)
		{
			uint8_t tag[16];

			BAES_CmacSetKey(pC->Key);
			BAES_CmacCompute(pC->Msg, split, nullptr);
			BAES_CmacCompute(pC->Msg + split, pC->Len - split, tag);
			ok = (memcmp(tag, pC->Tag, 16) == 0) && ok;
		}
	}
	check("BAES_CmacCompute, incremental whole-block appends", ok);
}

static bool CcmOne(const BtCcmCase_t *pC)
{
	uint8_t out[300];
	uint8_t tag[16];
	uint8_t back[300];
	uint8_t bad[16];
	bool ok;

	memset(out, 0xA5, sizeof(out));
	memset(tag, 0xA5, sizeof(tag));
	ok = BAES_CcmCrypt(0, pC->Key, 13, pC->Nonce, pC->AddLen, pC->Add,
					   pC->Len, pC->Pt, pC->TagLen, tag, out) == 0;
	ok = ok && memcmp(out, pC->Ct, pC->Len) == 0;
	ok = ok && memcmp(tag, pC->Tag, pC->TagLen) == 0;

	memset(back, 0xA5, sizeof(back));
	memcpy(tag, pC->Tag, pC->TagLen);
	ok = ok && BAES_CcmCrypt(1, pC->Key, 13, pC->Nonce, pC->AddLen, pC->Add,
							 pC->Len, pC->Ct, pC->TagLen, tag, back) == 0;
	ok = ok && memcmp(back, pC->Pt, pC->Len) == 0;

	memcpy(bad, pC->Tag, pC->TagLen);
	bad[0] ^= 1U;
	ok = ok && BAES_CcmCrypt(1, pC->Key, 13, pC->Nonce, pC->AddLen, pC->Add,
							 pC->Len, pC->Ct, pC->TagLen, bad, back) != 0;

	return ok;
}

static void CcmVectors(void)
{
	bool ok = true;

	for (unsigned i = 0; i < BT_NUM_CCM; i++)
	{
		ok = CcmOne(&g_CcmCase[i]) && ok;
	}
	check("BAES_CcmCrypt, seal, open and tag failure", ok);
}

static void Preempted(void)
{
	// Longest CMAC and CCM cases are last in the tables
	const BtCmacCase_t *pM = &g_CmacCase[BT_NUM_CMAC - 1];
	const BtCcmCase_t *pC = &g_CcmCase[BT_NUM_CCM - 1];
	uint8_t tag[16];
	uint8_t out[300];
	int before;

	// CMAC cut at its 3rd block
	s_IsrRuns = 0;
	s_IsrOk = false;
	before = g_Preempts;
	BtFwArm(3);
	BAES_CmacSetKey(pM->Key);
	memset(tag, 0xA5, sizeof(tag));
	BAES_CmacCompute(pM->Msg, pM->Len, tag);
	BtFwArm(0);
	check("CMAC with an interrupt call in the middle, task result",
		  memcmp(tag, pM->Tag, 16) == 0);
	check("CMAC with an interrupt call in the middle, interrupt result",
		  g_Preempts - before == 1 && s_IsrRuns == 1 && s_IsrOk);

	// CCM seal cut at its 5th block
	s_IsrRuns = 0;
	s_IsrOk = false;
	before = g_Preempts;
	BtFwArm(5);
	memset(out, 0xA5, sizeof(out));
	memset(tag, 0xA5, sizeof(tag));
	bool ok = BAES_CcmCrypt(0, pC->Key, 13, pC->Nonce, pC->AddLen, pC->Add,
							pC->Len, pC->Pt, pC->TagLen, tag, out) == 0;
	BtFwArm(0);
	check("CCM seal with an interrupt call in the middle, task result",
		  ok && memcmp(out, pC->Ct, pC->Len) == 0 &&
		  memcmp(tag, pC->Tag, pC->TagLen) == 0);
	check("CCM seal with an interrupt call in the middle, interrupt result",
		  g_Preempts - before == 1 && s_IsrRuns == 1 && s_IsrOk);

	// CCM open cut at its 4th block
	uint8_t back[300];

	s_IsrRuns = 0;
	s_IsrOk = false;
	before = g_Preempts;
	BtFwArm(4);
	memset(back, 0xA5, sizeof(back));
	memcpy(tag, pC->Tag, pC->TagLen);
	ok = BAES_CcmCrypt(1, pC->Key, 13, pC->Nonce, pC->AddLen, pC->Add,
					   pC->Len, pC->Ct, pC->TagLen, tag, back) == 0;
	BtFwArm(0);
	check("CCM open with an interrupt call in the middle, task result",
		  ok && memcmp(back, pC->Pt, pC->Len) == 0);
	check("CCM open with an interrupt call in the middle, interrupt result",
		  g_Preempts - before == 1 && s_IsrRuns == 1 && s_IsrOk);
}

static int PkaWait(void)
{
	s_PkaDone = false;
	BtFwPump();

	return s_PkaDone ? 1 : 0;
}

static void PkaVectors(void)
{
	bool okKey = true;
	bool okDh = true;
	bool okBusy = true;
	bool okEarly = true;

	for (unsigned i = 0; i < BT_NUM_PKA; i++)
	{
		const BtPkaCase_t *pC = &g_PkaCase[i];
		uint32_t priv[8];
		uint32_t peer[16];
		uint32_t pub[16];
		uint32_t dh[8];

		memcpy(priv, pC->Priv, 32);
		PKACTRL_Reset();

		// Public key. Read before the end is refused, a second start is busy.
		memset(pub, 0, sizeof(pub));
		okBusy = okBusy && PKACTRL_StartP256Key(priv) == 0;
		okBusy = okBusy && PKACTRL_StartP256Key(priv) == -2;
		okEarly = okEarly && PKACTRL_ReadP256Key(pub) == -3;
		okKey = okKey && PkaWait() == 1;
		okKey = okKey && PKACTRL_ReadP256Key(pub) == 0;
		okKey = okKey && memcmp(pub, pC->Pub, 64) == 0;

		// Shared secret with a valid peer
		memcpy(peer, pC->Peer, 64);
		memset(dh, 0, sizeof(dh));
		okBusy = okBusy && PKACTRL_StartDhKey(priv, peer) == 0;
		okBusy = okBusy && PKACTRL_StartDhKey(priv, peer) == -2;
		okEarly = okEarly && PKACTRL_ReadDhKey(dh) == -3;
		okDh = okDh && PkaWait() == 1;
		okDh = okDh && PKACTRL_ReadDhKey(dh) == 0;
		okDh = okDh && memcmp(dh, pC->Dh, 32) == 0;
	}
	check("PKACTRL_StartP256Key and ReadP256Key", okKey);
	check("PKACTRL_StartDhKey and ReadDhKey", okDh);
	check("second start while an operation is pending is busy", okBusy);
	check("read before the end of the operation is refused", okEarly);

	// A peer point off the curve: the end is reported, the secret is refused
	{
		uint32_t priv[8];
		uint32_t peer[16];
		uint32_t dh[8];

		memcpy(priv, g_PkaCase[0].Priv, 32);
		memcpy(peer, g_PkaBadPeer, 64);
		memset(dh, 0, sizeof(dh));
		PKACTRL_Reset();
		bool ok = PKACTRL_StartDhKey(priv, peer) == 0;
		ok = ok && PkaWait() == 1;
		ok = ok && PKACTRL_ReadDhKey(dh) == -3;
		bool zero = true;
		for (int i = 0; i < 8; i++)
		{
			zero = zero && dh[i] == 0;
		}
		check("peer point off the curve: operation ends, secret refused", ok);
		check("peer point off the curve: no secret is returned", zero);
	}

	// A private scalar of zero
	{
		uint32_t priv[8] = {};
		uint32_t pub[16];

		PKACTRL_Reset();
		bool ok = PKACTRL_StartP256Key(priv) == 0;
		ok = ok && PkaWait() == 1;
		ok = ok && PKACTRL_ReadP256Key(pub) == -3;
		check("private scalar 0: operation ends, key refused", ok);
	}
}

static void RngCheck(void)
{
	uint32_t a[4] = {};
	uint32_t b[4] = {};

	HW_RNG_Get(4, a);
	HW_RNG_Get(4, b);
	check("HW_RNG_Get gives different non zero words",
		  memcmp(a, b, sizeof(a)) != 0 && (a[0] | a[1] | a[2] | a[3]) != 0);
}

static void RunAll(void)
{
	printf("Bluetooth crypto hooks\r\n");
	EcbVectors();
	CmacVectors();
	CcmVectors();
	Preempted();
	PkaVectors();
	RngCheck();
	printf("\r\n%d passed, %d failed\r\n", s_Pass, s_Fail);
}

extern "C" int main(void)
{
	volatile unsigned idx = 0;
	void (* volatile pEntry)(void) = g_BtFwEntries[idx];

	(void)pEntry;
	RunAll();
	g_CryptoFwResult = s_Fail;
	CryptoFwDone();

	return 0;
}

// Minimal start: stack, data and bss, then main
extern "C" uint32_t _sidata, _sdata, _edata, _sbss, _ebss, _estack;

extern "C" void ResetHandler(void)
{
	uint32_t *src = &_sidata;

	for (uint32_t *dst = &_sdata; dst < &_edata; )
	{
		*dst++ = *src++;
	}
	for (uint32_t *dst = &_sbss; dst < &_ebss; )
	{
		*dst++ = 0;
	}
	main();
	while (1)
	{
	}
}

extern "C" __attribute__((section(".isr_vector"), used))
void (* const __Vectors[16 + 128])(void) = {
	(void (*)(void))&_estack,
	ResetHandler,
};
